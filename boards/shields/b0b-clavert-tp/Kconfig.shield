## boards/shields/b0b-clavert-tp/Kconfig.shield
```kconfig
# Copyright (c) 2020 Pete Johanson
# SPDX-License-Identifier: MIT

config SHIELD_B0B_CLAVERT_TP_LEFT
    def_bool $(shields_list_contains,b0b-clavert-tp-left)

config SHIELD_B0B_CLAVERT_TP_RIGHT
    def_bool $(shields_list_contains,b0b-clavert-tp-right)
```
